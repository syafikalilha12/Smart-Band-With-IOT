#include <ESP8266HTTPClient.h>
#include <BlynkSimpleEsp8266.h>
#include <SimpleTimer.h>
#define BLYNK_PRINT Serial
#include <Blynk.h>
#include <time.h>
#include <ESP8266WiFi.h>
#include <NTPClient.h>
#include <WiFiUdp.h>
#include <SPI.h>
#include <Wire.h>
#include <Adafruit_GFX.h>
#include <Adafruit_SSD1306.h>
#include "MAX30105.h"
#include "spo2_algorithm.h"
#include <Adafruit_MLX90614.h>
#include <DHT.h>
#define PIN D5
#define TYPE DHT11
DHT dht(PIN,TYPE);
int te,tt;
Adafruit_MLX90614 mlx = Adafruit_MLX90614();

MAX30105 particleSensor;
#define SCREEN_WIDTH 128
#define SCREEN_HEIGHT 64
#define OLED_RESET -1
Adafruit_SSD1306 display(SCREEN_WIDTH, SCREEN_HEIGHT, &Wire, OLED_RESET);
#define NUMFLAKES 10
#define LOGO_HEIGHT 16
#define LOGO_WIDTH 16
#define button D5
String jam;

const unsigned char myBitmap[] PROGMEM = {
    0x00, 0x00, 0x00, 0x00, 0x00, 0x00, 0x00, 0x00, 0x00, 0x00, 0x00, 0x00, 0x00, 0x00, 0x00, 0x00,
    0x00, 0x00, 0x00, 0x00, 0x00, 0x00, 0x00, 0x00, 0x00, 0x00, 0x00, 0x00, 0x00, 0x00, 0x00, 0x00,
    0x00, 0x00, 0x00, 0x00, 0x00, 0x00, 0x00, 0x00, 0x00, 0x00, 0x00, 0x00, 0x00, 0x00, 0x00, 0x00,
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    0x00, 0x00, 0x00, 0x00, 0x00, 0x00, 0x00, 0x00, 0x00, 0x00, 0x00, 0x00, 0x00, 0x00, 0x00, 0x00};

const unsigned char meka [] PROGMEM = {
  0x00, 0x00, 0x07, 0xf0, 0x00, 0x00, 0x00, 0x00, 0x00, 0x0f, 0xfc, 0x00, 0x00, 0x00, 0x00, 0x00, 
  0x0f, 0xfc, 0x00, 0x00, 0x00, 0x00, 0x00, 0x0f, 0xfc, 0x00, 0x00, 0x00, 0x00, 0x00, 0x0f, 0xff, 
  0xc0, 0x00, 0x00, 0x00, 0x00, 0x0f, 0xff, 0xf1, 0x80, 0x00, 0x00, 0x00, 0x18, 0x0f, 0xfb, 0xc0, 
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  0x20, 0x00, 0x04, 0x58, 0xaa, 0x88, 0xaa, 0xa4, 0x00, 0x03, 0x4b, 0xaa, 0x6e, 0xaa, 0x98, 0x00
};

const unsigned char company [] PROGMEM = {
  0x00, 0x00, 0x0e, 0x00, 0x00, 0x00, 0x00, 0x00, 0x00, 0x00, 0x00, 0x00, 0x00, 0x00, 0x00, 0x00, 
  0x00, 0x00, 0x1f, 0x00, 0x00, 0x00, 0x00, 0x00, 0x00, 0x00, 0x00, 0x00, 0x00, 0x00, 0x00, 0x00, 
  0x00, 0x00, 0x1f, 0x80, 0x00, 0x00, 0x00, 0x00, 0x00, 0x00, 0x00, 0x00, 0x00, 0x00, 0x00, 0x00, 
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  0x00, 0x00, 0x0e, 0x00, 0x00, 0x00, 0x00, 0x00, 0x00, 0x00, 0x00, 0x00, 0x00, 0x00, 0x00, 0x00
};

#define MAX_BRIGHTNESS 255
#if defined(__AVR_ATmega328P__) || defined(__AVR_ATmega168__)
uint16_t irBuffer[100];
uint16_t redBuffer[100];
#else
uint32_t irBuffer[100];
uint32_t redBuffer[100];
#endif
int32_t bufferLength;
int32_t spo2;
int8_t validSPO2;
int32_t heartRate;
int8_t validHeartRate;

unsigned long previousMillis = 0;
const long period = 4000;
unsigned long previousMillis1 = 0; //will store last time LED was blinked
const long period1 = 8000;
char auth[] = "uP5DVLZKHumKZU2B-uexnDsBeD7ZNHGe";
const char *ssid = "AndroidAP8201";
const char *password = "qwertyuiop1";
int mode = 0;
byte readLED = D4;
byte pulseLED = D1;


WiFiUDP ntpUDP;
NTPClient timeClient(ntpUDP, "asia.pool.ntp.org", 28200, 60000);
String weekDays[7] = {"Sunday", "Monday", "Tuesday", "Wednesday", "Thursday", "Friday", "Saturday"};
String months[12] = {"January", "February", "March", "April", "May", "June", "July", "August", "September", "October", "November", "December"};

void time()
{
  timeClient.update();
  unsigned long epochTime = timeClient.getEpochTime();
  String formattedTime = timeClient.getFormattedTime();
  Serial.print("Formatted Time: ");
  Serial.println(formattedTime);
  int currentHour = timeClient.getHours();
  int currentMinute = timeClient.getMinutes();
  int currentSecond = timeClient.getSeconds();

  String weekDay = weekDays[timeClient.getDay()];
  struct tm *ptm = gmtime((time_t *)&epochTime);
  int monthDay = ptm->tm_mday;
  int currentMonth = ptm->tm_mon + 1;
  String currentMonthName = months[currentMonth - 1];
  int currentYear = ptm->tm_year + 1900;
  String currentDate = String(currentYear) + "-" + String(currentMonth) + "-" + String(monthDay);
  display.display();
  display.clearDisplay();
  display.setTextSize(3);
  display.setTextColor(WHITE);
  display.setCursor(20, 0);
  display.print(currentHour);
  display.print(":");
  display.println(currentMinute);
  jam = String(currentHour) + ":" + String(currentMinute) + ":" + String(currentSecond);

  display.setTextSize(1);
  display.setTextColor(WHITE);
  display.setCursor(5, 30);
  display.print(weekDay);
  display.print("/");
  display.print(monthDay);
  display.print("-");
  display.print(currentMonth);
  display.print("-");
  display.println(currentYear);
  display.setTextSize(1);
  display.setTextColor(WHITE);
  display.setCursor(20, 40);
  display.print("Surabaya  35'");
  Serial.print("Current date: ");
  Serial.println(currentDate);
  Serial.println("");
}

void time1()
{
  tt=dht.readTemperature();
  if(isnan(tt) || tt>50)
  {
    te=te;
  }
  else
  {
    te=tt;
  }
  timeClient.update();
  unsigned long epochTime = timeClient.getEpochTime();
  String formattedTime = timeClient.getFormattedTime();
  Serial.print("Formatted Time: ");
  Serial.println(formattedTime);
  int currentHour = timeClient.getHours();
  int currentMinute = timeClient.getMinutes();
  int currentSecond = timeClient.getSeconds();

  String weekDay = weekDays[timeClient.getDay()];
  struct tm *ptm = gmtime((time_t *)&epochTime);
  int monthDay = ptm->tm_mday;
  int currentMonth = ptm->tm_mon + 1;
  String currentMonthName = months[currentMonth - 1];
  int currentYear = ptm->tm_year + 1900;
  String currentDate = String(currentYear) + "-" + String(currentMonth) + "-" + String(monthDay);
  display.display();
  display.clearDisplay();
  display.setTextSize(3);
  display.setTextColor(WHITE);
  display.setCursor(20, 0);
  display.print(currentHour);
  display.print(":");
  display.println(currentMinute);
  display.setTextSize(1);
  display.setTextColor(WHITE);
  display.setCursor(0, 30);
  display.setTextSize(1);
  display.setTextColor(WHITE);
  display.setCursor(0, 40);
  display.print("SUHU TUBUH: ");
  display.print(te);
  display.setTextColor(WHITE);
  display.setCursor(0, 55);
  display.print("HR");
  display.print(heartRate, DEC);
  display.print("Bpm");
  display.print(" SpO2:");
  display.print(spo2, DEC);
  display.print("%");
}

void Displayconnect()
{
  display.display();
  delay(100); //OLED
  display.clearDisplay();
  display.setTextSize(1);
  display.setTextColor(SSD1306_WHITE);
  display.setCursor(0, 0);
  display.println(F("Connecting to wifi.."));
  display.setTextSize(3);
  display.setTextColor(WHITE);
  display.setCursor(10, 15);
  display.print("SYAFIK");
  display.setTextSize(1);
  display.setTextColor(WHITE);
  display.setCursor(10, 50);
  display.print("NRP 3110181057");
}

void setup()
{
  Serial.begin(115200);
  pinMode(button, INPUT_PULLUP);
  pinMode(readLED, OUTPUT);
  pinMode(pulseLED, OUTPUT);
  mlx.begin();
  if (!display.begin(SSD1306_SWITCHCAPVCC, 0x3C))
  {
    Serial.println(F("SSD1306 allocation failed"));
    for (;;)
      ;
  }
  display.begin(SSD1306_SWITCHCAPVCC, 0x3C); //or 0x3C
  display.clearDisplay();                    //for Clearing the display
  display.drawBitmap(27, 0, myBitmap, 128, 64, WHITE);
  display.display();
  delay(2000);
  display.begin(SSD1306_SWITCHCAPVCC, 0x3C); //or 0x3C
  display.clearDisplay();                    //for Clearing the display
  display.drawBitmap(40, 0, meka, 51, 64, WHITE);
  display.display();
  delay(2000);
  display.begin(SSD1306_SWITCHCAPVCC, 0x3C); //or 0x3C
  display.clearDisplay();                    //for Clearing the display
  display.drawBitmap(0, 0, company, 128, 64, WHITE);
  display.display();
  delay(2000);
  display.clearDisplay();
  Serial.print("Connecting to ");
  Serial.println(ssid);
  WiFi.begin(ssid, password);
  while (WiFi.status() != WL_CONNECTED)
  {
    delay(500);
    Serial.print(".");
    Displayconnect();
  }
  timeClient.begin();
  timeClient.setTimeOffset(25200);

  if (!particleSensor.begin(Wire, I2C_SPEED_FAST))
  {
    Serial.println(F("MAX30105 was not found. Please check wiring/power."));
    while (1)
      ;
  }
  byte ledBrightness = 60;
  byte sampleAverage = 4;
  byte ledMode = 2;
  byte sampleRate = 100;
  int pulseWidth = 411;
  int adcRange = 4096;

  particleSensor.setup(ledBrightness, sampleAverage, ledMode, sampleRate, pulseWidth, adcRange);
  bufferLength = 100;
  for (byte i = 0; i < bufferLength; i++)
  {
    while (particleSensor.available() == false)
      particleSensor.check();

    redBuffer[i] = particleSensor.getRed();
    irBuffer[i] = particleSensor.getIR();
    particleSensor.nextSample();
    Serial.print(F("red="));
    Serial.print(redBuffer[i], DEC);
    Serial.print(F(", ir="));
    Serial.println(irBuffer[i], DEC);
    display.display();
    delay(100);
    display.clearDisplay();
    display.setTextSize(1);
    display.setTextColor(SSD1306_WHITE);
    display.setCursor(0, 0);
    display.println(F("Getting Parameters"));
    display.setTextSize(3);
    display.setTextColor(WHITE);
    display.setCursor(20, 20);
    display.print(irBuffer[i], DEC);
  }
  Blynk.begin(auth, ssid, password);
}
void pb_mode()
{
  if (digitalRead(button) == 0)
    mode = 1;
}

void loop()
{
awal:
  pb_mode();
  maxim_heart_rate_and_oxygen_saturation(irBuffer, bufferLength, redBuffer, &spo2, &validSPO2, &heartRate, &validHeartRate);

  for (byte i = 25; i < 100; i++)
  {
    redBuffer[i - 25] = redBuffer[i];
    irBuffer[i - 25] = irBuffer[i];
  }
  for (byte i = 75; i < 100; i++)
  {
    while (particleSensor.available() == false)
      particleSensor.check();
    redBuffer[i] = particleSensor.getRed();
    irBuffer[i] = particleSensor.getIR();
    particleSensor.nextSample();

    unsigned long currentMillis = millis();
    if (currentMillis - previousMillis >= period)
    {
      previousMillis = currentMillis;
      digitalWrite(readLED, !digitalRead(readLED));
      Serial.print(F(", SPO2=  "));
      Serial.println(spo2, DEC);
      Serial.print(F(", HR=  "));
      Serial.println(heartRate, DEC);
      time1();
      maxim_heart_rate_and_oxygen_saturation(irBuffer, bufferLength, redBuffer, &spo2, &validSPO2, &heartRate, &validHeartRate);
    }
     if (currentMillis - previousMillis1 >= period1)
      {
      previousMillis1 = currentMillis;
      time();
      }
  }
  mode = 0;
  pb_mode();
  goto awal;
}
